## Config.in
```kconfig
config BR2_INIT_66
	bool "66"
	select BR2_PACKAGE_66
	select BR2_PACKAGE_BOOT_66SERV

source "$BR2_EXTERNAL_66_PATH/package/Config.in"
```

## configs/qemu_aarch64_virt_defconfig
```kconfig
# Architecture
BR2_aarch64=y
BR2_cortex_a53=y

# Toolchain
BR2_TOOLCHAIN_EXTERNAL=y
BR2_TOOLCHAIN_EXTERNAL_ARM_AARCH64=y

# System
BR2_INIT_66=y
BR2_INIT_NONE=y
BR2_SYSTEM_DHCP="eth0"
BR2_TARGET_GENERIC_GETTY_PORT="ttyAMA0"

# Filesystem
BR2_TARGET_ROOTFS_EXT2=y
BR2_TARGET_ROOTFS_EXT2_4=y
# BR2_TARGET_ROOTFS_TAR is not set

# Linux headers same as kernel, a 4.19 series
BR2_PACKAGE_HOST_LINUX_HEADERS_CUSTOM_4_19=y

# Kernel
BR2_LINUX_KERNEL=y
BR2_LINUX_KERNEL_CUSTOM_VERSION=y
BR2_LINUX_KERNEL_CUSTOM_VERSION_VALUE="4.19.91"
BR2_LINUX_KERNEL_USE_CUSTOM_CONFIG=y
BR2_LINUX_KERNEL_CUSTOM_CONFIG_FILE="$(BR2_EXTERNAL_66_PATH)/board/qemu/aarch64-virt/linux.config"
```

## package/66-tools/Config.in
```kconfig
config BR2_PACKAGE_66_TOOLS
	bool "66"
	depends on BR2_USE_MMU # execline
	select BR2_PACKAGE_OBLIBS
	help
	  A collection of helpers tools to accomplish various
	  and repetitive tasks in 66 service scripts.

	  https://web.obarun.org/software/66-tools/
```

## package/66/Config.in
```kconfig
config BR2_PACKAGE_66
	bool "66"
	depends on BR2_USE_MMU # execline
	depends on BR2_USE_WCHAR
	select BR2_PACKAGE_OBLIBS
	select BR2_PACKAGE_S6_RC
	help
	  A collection of system tools built around s6 and s6-rc
	  created to make the implementation and manipulation of
	  service files on your machine easier.

	  https://web.obarun.org/software/66/

comment "66 needs a toolchain w/ wchar"
	depends on !BR2_USE_WCHAR
```

## package/Config.in
```kconfig
source "$BR2_EXTERNAL_66_PATH/package/oblibs/Config.in"
source "$BR2_EXTERNAL_66_PATH/package/66-tools/Config.in"
source "$BR2_EXTERNAL_66_PATH/package/boot-66serv/Config.in"
source "$BR2_EXTERNAL_66_PATH/package/66/Config.in"
```

## package/boot-66serv/Config.in
```kconfig
config BR2_PACKAGE_BOOT_66SERV
	bool "boot-66serv"
	# below are runtime dependencies
	select BR2_PACKAGE_BASH
	select BR2_PACKAGE_KMOD
	select BR2_PACKAGE_KMOD_TOOLS
	select BR2_PACKAGE_66_TOOLS
	select BR2_PACKAGE_BUSYBOX_SHOW_OTHERS
	select BR2_PACKAGE_IPROUTE2
	select BR2_PACKAGE_S6_LINUX_UTILS
	select BR2_PACKAGE_S6_PORTABLE_UTILS
	help
	  Portable set of service to boot a machine in conjunction with 66 API.

	  https://framagit.org/Obarun/boot-66serv/
```

## package/oblibs/Config.in
```kconfig
config BR2_PACKAGE_OBLIBS
	bool "oblibs"
	depends on BR2_USE_MMU # execline
	select BR2_PACKAGE_EXECLINE
	help
	  Obarun libraries.

	  https://web.obarun.org/
```
